/**
 @file
 @brief Signal generator for 128x32 DMD display
 @version 1.0
 @author Arco van Geest <arco@appeltaart.mine.nu>
 @copyright 2020 Arco van Geest <arco@appeltaart.mine.nu> All right reserved.

  This is distributed in the hope that it will be useful,
  but WITHOUT ANY WARRANTY; without even the implied warranty of
  MERCHANTABILITY or FITNESS FOR A PARTICULAR PURPOSE.  See the
  GNU General Public License for more details.

  You should have received a copy of the GNU General Public License
  along with this file.  If not, see <http://www.gnu.org/licenses/>.

 @date       20200701 Initial version
 @date       20200719 Cherry not working. Reverted to digital write for next row.

 @details  Based on code from Adam Preble http://adampreble.net/blog/2009/12/arduino-pinball-dmd/
   I changed the hardware to a mega2560 and tried to improve speed.
   The display shows the high page twice and the low page once. resulting in 66%/33% for HIGH/LOW.
   The refresh rate is around 195Hz per page. 95Hz for full frames.
 
*/
// DEBUG shows the refreshrate per plane on the serial monitor.
//#define DEBUG

#include "string.h"
#include <SPI.h>

void UpdateDMD();
void FrameToSerial();

#define CLKPORT PORTH   //control lines are on a single port for speed

#define DMD_ENABLE 3    // ARDUINO pin 6 PH3 DMD pin 1
#define DMD_ROWDATA  4  //ARDUINO pin 7 PH4 DMD pin 3
#define DMD_ROWCLOCK 5  //ARDUINO pin 8 PH5 DMD pin 5
#define DMD_COLLATCH 6  // ARDUINO pin 9 PH6 DMD pin 7

#define pinDisplayEnable 6 // DMD pin 1
#define pinRowData  7   // One pin 3
#define pinRowClock 8   // DMD pin 5
#define pinColLatch 9   // DMD pin 7

// driven by SPI
// Arduino / Genuino Board  MOSI          MISO          SCK SS (slave)  SS (master) Level
// Uno or Duemilanove       11 or ICSP-4  12 or ICSP-1  13 or ICSP-3    10  -       5V
// Mega1280 or Mega2560     51 or ICSP-4  50 or ICSP-1  52 or ICSP-3    53  -       5V
#define pinDotClock 52        // DMD pin 9
#define pinDotData  51        // DMD pin 11
#define pinSPISlaveSelect 53  // SPI slave select, unused 
#define pinSPIIn 50           // SPI MISO, unused

#define rowCount 32
#define colCount 128
#define bytesPerRow (colCount / 8)

#define frameSize 512 // 4096/4 

// framedata 512 HIGH, 512 LOW
byte frame[frameSize*2] = {
B11111111,B11111111,B11111111,B11111111,B11111111,B11111111,B11111111,B11111111,B11111111,B11111111,B11111111,B11111100,B01111111,B11111111,B11111111,B11111111,
B10000000,B00000000,B00000000,B00000000,B00000000,B00000000,B00000000,B00000000,B00000000,B00000000,B00010000,B00000001,B00000000,B00000001,B00000000,B00000011,
B10011100,B11001111,B00110001,B00001110,B00100010,B11100000,B00000111,B11011111,B00111101,B11110000,B00100000,B00000010,B00000000,B00000001,B00000000,B00000101,
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B11111111,B11111111,B11111111,B11111111,B11111111,B11111111,B11111111,B11111111,B11111111,B11111111,B11111110,B00011111,B01111111,B11111111,B11111111,B11111111,                                                                                                                                                          

};
int clr; // temp variable for SPI I/O.
unsigned long t0; //timer 

void setup() { 
  pinMode(pinDotClock, OUTPUT);
  pinMode(pinColLatch, OUTPUT);
  pinMode(pinDotData, OUTPUT);
  pinMode(pinRowData, OUTPUT);
  pinMode(pinRowClock, OUTPUT);
  pinMode(pinDisplayEnable, OUTPUT);

  pinMode(pinSPIIn, INPUT);
  pinMode(pinSPISlaveSelect, OUTPUT);
  digitalWrite(pinSPISlaveSelect, HIGH);
  
  digitalWrite(pinDisplayEnable, LOW);
  digitalWrite(pinRowData, LOW);
  digitalWrite(pinRowClock, HIGH); // Normal state is HIGH.
  digitalWrite(pinDotClock, LOW);
  digitalWrite(pinDotData, LOW);
  digitalWrite(pinColLatch, LOW);

  // SPCR = 01010000
  //interrupt disabled,spi enabled,msb 1st,master,clk low when idle,
  //sample on leading edge of clk,system clock/4 rate (fastest)

//Mode  Clock Polarity (CPOL) Clock Phase (CPHA)  Output Edge Data Capture
//SPI_MODE0 0 0 Falling Rising
//SPI_MODE1 0 1 Rising  Falling
//SPI_MODE2 1 0 Rising  Falling
//SPI_MODE3 1 1 Falling Rising
  
  SPCR = (1<<SPE)|(1<<MSTR)  |(1<<CPOL)|(1<<CPHA);//|0x3; // slowest
  SPSR |= 1; // set spi*2
//  SPSR = 0; // set spi*1
  clr=SPSR;
  clr=SPDR;
  delay(10);
  #ifdef DEBUG
  Serial.begin(9600);
  Serial.println("Booted.");
  #endif
  //FrameToSerial();
  UpdateDMD(0);
#ifdef DEBUG
  t0=millis();
#endif
  
} //setup

unsigned long t1; //timer
int frames = 0;

void loop() {
  // 66% high
  UpdateDMD(0);
  UpdateDMD(0);
  // 33% low
  UpdateDMD(1);
  
#ifdef DEBUG
  frames+=3;
  t1 = millis();
  if((t1 - t0) > 10000) {
    Serial.print(frames/10, DEC);
    Serial.println("Hz");
    frames=0;
    t0=millis();
  //  digitalWrite(pinDisplayEnable, LOW);
  //  while(1);
  }
#endif

} //loop

void UpdateDMD(int bank ) {
  for(int row = 0; row < rowCount; row++) {
    delayMicroseconds(125);
 
    // send pixel data
    int offset = (bank * 512 )+row * bytesPerRow;

    // unlooped pixel send through spi
    SPDR = frame[offset];
    while (!(SPSR & (1<<SPIF)));
    offset++;
    SPDR = frame[offset];
    while (!(SPSR & (1<<SPIF)));
    offset++;
    SPDR = frame[offset];
    while (!(SPSR & (1<<SPIF)));
    offset++;
    SPDR = frame[offset];
    while (!(SPSR & (1<<SPIF)));
    offset++;
    SPDR = frame[offset];
    while (!(SPSR & (1<<SPIF)));
    offset++;
    SPDR = frame[offset];
    while (!(SPSR & (1<<SPIF)));
    offset++;
    SPDR = frame[offset];
    while (!(SPSR & (1<<SPIF)));
    offset++;
    SPDR = frame[offset];
    while (!(SPSR & (1<<SPIF)));
    offset++;
    SPDR = frame[offset];
    while (!(SPSR & (1<<SPIF)));
    offset++;
    SPDR = frame[offset];
    while (!(SPSR & (1<<SPIF)));
    offset++;
    SPDR = frame[offset];
    while (!(SPSR & (1<<SPIF)));
    offset++;
    SPDR = frame[offset];
    while (!(SPSR & (1<<SPIF)));
    offset++;
    SPDR = frame[offset];
    while (!(SPSR & (1<<SPIF)));
    offset++;
    SPDR = frame[offset];
    while (!(SPSR & (1<<SPIF)));
    offset++;
    SPDR = frame[offset];
    while (!(SPSR & (1<<SPIF)));
    offset++;
    SPDR = frame[offset];
    while (!(SPSR & (1<<SPIF)));

    //digitalWrite(pinDisplayEnable, LOW);  // Turn off the display while we latch in the this row.
    CLKPORT &= ~(1<<DMD_ENABLE);     // Turn off the display while we latch in the this row.

    CLKPORT |= (1<<DMD_COLLATCH);   //latch pixel data
    CLKPORT &= ~(1<<DMD_COLLATCH);
    
    if(row == 0) {                  // On first row rowdata=1
      CLKPORT |= (1<<DMD_ROWDATA);
    } else {
      CLKPORT &= ~(1<<DMD_ROWDATA);
    }

    //CLKPORT &= ~(1<<DMD_ROWCLOCK);  // next row
    //    __asm__("nop\n\t"); //62ns 
    //delayMicroseconds(200); 
    //CLKPORT |= (1<<DMD_ROWCLOCK);
    
    digitalWrite(pinRowClock, LOW);   // Advance the row pointer.
    // not sure why the bit method does not work here
    //CLKPORT &= ~(1<<DMD_ROWCLOCK);  // next row
    //delayMicroseconds(1);             // Minimum 1us dip
 //   digitalWrite(pinRowClock, HIGH);
   CLKPORT |= (1<<DMD_ROWCLOCK);
 
    
    //digitalWrite(pinDisplayEnable, HIGH);  // Turn on the display now that the column outputs are latched.
    CLKPORT |= (1<<DMD_ENABLE);     // enable display
    // clear first row data 
    CLKPORT &= ~(1<<DMD_ROWDATA);

  }
}

void FrameToSerial() {
  for(int i = 0; i < frameSize; i++) {
    if((i % bytesPerRow) == 0) {
      Serial.println();
    }
    for(int bit = 7; bit >= 0; bit--) {
      Serial.print((frame[i] >> bit) & 1, HEX);
    }
  }
}
