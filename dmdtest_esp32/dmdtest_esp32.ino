/**
 @file
 @brief Signal generator for 128x32 DMD display
 @version 1.0
 @author Arco van Geest <arco@appeltaart.mine.nu>
 @copyright 2021 Arco van Geest <arco@appeltaart.mine.nu> All right reserved.

  This is distributed in the hope that it will be useful,
  but WITHOUT ANY WARRANTY; without even the implied warranty of
  MERCHANTABILITY or FITNESS FOR A PARTICULAR PURPOSE.  See the
  GNU General Public License for more details.

  You should have received a copy of the GNU General Public License
  along with this file.  If not, see <http://www.gnu.org/licenses/>.

 @date       20200701 Initial version
 @date       20210901 Initial version for ESP32

 @details  Based on code from Adam Preble http://adampreble.net/blog/2009/12/arduino-pinball-dmd/
   I changed the hardware to a ESP32 and tried to improve speed.
   The display shows the high page twice and the low page once. resulting in 66%/33% for HIGH/LOW.
   The refresh rate is around unknown per page. Unknown for full frames.
 
*/
// DEBUG shows the refreshrate per plane on the serial monitor.
//#define DEBUG

#include "string.h"
#include <SPI.h>

SPIClass * vspi = NULL;
static const int spiClk = 10000000; // 10 MHz
  
void UpdateDMD();
void FrameToSerial();

#define pinDisplayEnable 19 // DMD pin 1
#define pinRowData  18   // One pin 3
#define pinRowClock 5   // DMD pin 5
#define pinColLatch 17   // DMD pin 7
#define VSPI_SCLK   16
#define VSPI_MOSI   4

//I don't know if I need to assign outputs...
#define pinDotData  4   // One pin 3
#define pinDotClock 16   // DMD pin 5

  
#define VSPI_MISO   2
#define VSPI_SS     33

#define rowCount 32
#define colCount 128
#define bytesPerRow (colCount / 8)

#define frameSize 512 // 4096/4 

// framedata 512 HIGH, 512 LOW
byte frame[frameSize*2] = {
B11111111,B11111111,B11111111,B11111111,B11111111,B11111111,B11111111,B11111111,B11111111,B11111111,B11111111,B11111100,B01111111,B11111111,B11111111,B11111111,
B10000000,B00000000,B00000000,B00000000,B00000000,B00000000,B00000000,B00000000,B00000000,B00000000,B00010000,B00000001,B00000000,B00000001,B00000000,B00000011,
B10011100,B11001111,B00110001,B00001110,B00100010,B11100000,B00000111,B11011111,B00111101,B11110000,B00100000,B00000010,B00000000,B00000001,B00000000,B00000101,
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B11111111,B11111111,B11111111,B11111111,B11111111,B11111111,B11111111,B11111111,B11111111,B11111111,B11111110,B00011111,B01111111,B11111111,B11111111,B11111111,                                                                                                                                                          

};
int clr; // temp variable for SPI I/O.
unsigned long t0; //timer 

void setup() { 


  pinMode(pinDotClock, OUTPUT);
  pinMode(pinColLatch, OUTPUT);
  pinMode(pinDotData, OUTPUT);
  pinMode(pinRowData, OUTPUT);
  pinMode(pinRowClock, OUTPUT);
  pinMode(pinDisplayEnable, OUTPUT);

  digitalWrite(pinDisplayEnable, LOW);
  digitalWrite(pinRowData, LOW);
  digitalWrite(pinRowClock, HIGH); // Normal state is HIGH.
  digitalWrite(pinColLatch, LOW);

  vspi = new SPIClass(VSPI);
  vspi->begin(VSPI_SCLK, VSPI_MISO, VSPI_MOSI, VSPI_SS); //SCLK, MISO, MOSI, SS
  vspi->beginTransaction(SPISettings(spiClk, MSBFIRST, SPI_MODE3));

  delay(10);
  #ifdef DEBUG
  Serial.begin(9600);
  Serial.println("Booted.");
  #endif
  //FrameToSerial();
  UpdateDMD(0);
#ifdef DEBUG
  t0=millis();
#endif
  
} //setup

unsigned long t1; //timer
int frames = 0;

void loop() {
  // 66% high
  UpdateDMD(0);
  UpdateDMD(0);
  // 33% low
  UpdateDMD(1);
  
#ifdef DEBUG
  frames+=3;
  t1 = millis();
  if((t1 - t0) > 10000) {
    Serial.print(frames/10, DEC);
    Serial.println("Hz");
    frames=0;
    t0=millis();
  //  digitalWrite(pinDisplayEnable, LOW);
  //  while(1);
  }
#endif

} //loop

void UpdateDMD(int bank ) {
  for(int row = 0; row < rowCount; row++) {
    //delayMicroseconds(125);
    delayMicroseconds(50);
 
    // start of pixel data
    int offset = (bank * 512 )+row * bytesPerRow;

    for(int i=0; i<bytesPerRow; i++){
      vspi->transfer(frame[offset++]);
      //    vspi->transfer(0x50+row);
    }

    digitalWrite(pinDisplayEnable, LOW);  // Turn off the display while we latch in the this row.
    //delayMicroseconds(1); 
    digitalWrite(pinColLatch, HIGH);
    //delayMicroseconds(10);  
    digitalWrite(pinColLatch, LOW);

    if(row == 0) {                  // On first row rowdata=1
      digitalWrite(pinRowData, HIGH);
    } else {
      digitalWrite(pinRowData, LOW);
    }
    
    digitalWrite(pinRowClock, LOW);   // Advance the row pointer.
    delayMicroseconds(1);             // Minimum 1us dip
    digitalWrite(pinRowClock, HIGH);
    
    digitalWrite(pinDisplayEnable, HIGH);  // Turn on the display now that the column outputs are latched.
        //        delayMicroseconds(1);  
    // clear first row data 
    digitalWrite(pinRowData, LOW);
      //    delayMicroseconds(1);  
  }
}

void FrameToSerial() {
  for(int i = 0; i < frameSize; i++) {
    if((i % bytesPerRow) == 0) {
      Serial.println();
    }
    for(int bit = 7; bit >= 0; bit--) {
      Serial.print((frame[i] >> bit) & 1, HEX);
    }
  }
}
